## drivers/misc/fingerprint/Kconfig
```kconfig
source "drivers/misc/fingerprint/cdfinger_fp/Kconfig"
source "drivers/misc/fingerprint/focal_fp/Kconfig"
```

## drivers/misc/fingerprint/cdfinger_fp/Kconfig
```kconfig
config CDFINGER_FP
	bool "CDFINGER_FP for Qualcomm package"
	help
	  Say Y here if you have a cdfinger fingerprint.

	  If unsure, say N.
```

## drivers/misc/fingerprint/focal_fp/Kconfig
```kconfig
config FOCAL_FP
	bool "FOCAL_FP for Qualcomm package"
	help
	  Say Y here if you have a focal fingerprint.

	  If unsure, say N.
```

## drivers/platform/asus/Kconfig
```kconfig
# Asus X00P configuration options

config MACH_ASUS_X01AD
	bool "Asus X01AD"
	depends on ARCH_SDM632
	help
	  Support for Asus X01AD
```
